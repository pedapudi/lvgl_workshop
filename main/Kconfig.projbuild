## main/Kconfig.projbuild
```kconfig
menu "Animation Workshop"

    config USE_KCONFIG_PHASE
        bool "Use Menuconfig Phase (Override workshop_config.h)"
        default n
        help
            If enabled, the WORKSHOP_PHASE will be taken from this menu.
            If disabled, the manual #define in main/workshop_config.h will be used.

    config WORKSHOP_PHASE
        depends on USE_KCONFIG_PHASE
        int "Workshop Optimization Phase (1-5)"
        range 1 5
        default 1
        help
            Select the optimization phase (1-5).
            1: Baseline (160MHz CPU, 20MHz SPI)
            2: Foundation (240MHz CPU, 80MHz SPI)
            3: Parallelism (Double Buffering)
            4: Expert (Full Frame PSRAM, SIMD)
            5: Native (Native Driver, SWAR)

endmenu
```

## sdkconfig.defaults
```kconfig
CONFIG_LV_FONT_MONTSERRAT_14=y
CONFIG_LV_FONT_MONTSERRAT_20=y
CONFIG_LV_USE_LOG=y
CONFIG_LV_LOG_LEVEL_INFO=y
CONFIG_LV_LOG_PRINTF=n
CONFIG_LV_USE_VECTOR_GRAPHIC=y
CONFIG_LV_USE_THORVG=y
CONFIG_LV_USE_SVG=y
CONFIG_LV_USE_SVG_ANIMATION=y

# Free up GPIO 43/44 (D6/D7) by switching console to USB Serial/JTAG
CONFIG_ESP_CONSOLE_UART_NONE=y
CONFIG_ESP_CONSOLE_USB_SERIAL_JTAG=y

# Performance optimization for ThorVG/SVG
CONFIG_ESP_DEFAULT_CPU_FREQ_MHZ_240=y
CONFIG_ESP_DEFAULT_CPU_FREQ_MHZ=240
CONFIG_ESP_TASK_WDT_TIMEOUT_S=30
CONFIG_ESP_TASK_WDT_PANIC=y
CONFIG_LV_MEM_SIZE_KILOBYTES=128
CONFIG_LV_USE_BUILTIN_MALLOC=n
CONFIG_LV_USE_CLIB_MALLOC=y

# Optimization: Performance (-O3) + LTO (SAFE)
CONFIG_COMPILER_OPTIMIZATION_PERF=y
CONFIG_COMPILER_OPTIMIZATION_LTO=y

# Single-Core High Performance (Avoiding FreeRTOS conflicts)
CONFIG_LV_OS_NONE=y
CONFIG_LV_DRAW_SW_DRAW_UNIT_CNT=1

# Diagnostics: Performance Monitor (FPS/CPU)
CONFIG_LV_USE_SYSMON=y
CONFIG_LV_USE_PERF_MONITOR=y
CONFIG_LV_PERF_MONITOR_ALIGN_TOP_MID=y

# SPIRAM: Enable 8MB Octal PSRAM
CONFIG_SPIRAM=y
CONFIG_SPIRAM_TYPE_AUTO=y
CONFIG_SPIRAM_MODE_OCT=y
CONFIG_SPIRAM_SPEED_80M=y
CONFIG_SPIRAM_BOOT_INIT=y
CONFIG_SPIRAM_USE_MALLOC=y
CONFIG_SPIRAM_MALLOC_RESERVE_INTERNAL=32768

# LVGL Cache: 2MB in PSRAM
CONFIG_LV_CACHE_DEF_SIZE=2097152
CONFIG_PM_ENABLE=y
```
